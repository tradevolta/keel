/* SPDX-License-Identifier: Apache-2.0 */
/* Generated by tools/memgen from memory.toml: do not edit.
   ST NUCLEO-G474RE: STM32G474RE, 512 KB flash */
MEMORY
{
  flash (rx) : ORIGIN = 0x08000000, LENGTH = 512K
  sram (rwx) : ORIGIN = 0x20000000, LENGTH = 96K
  ccmsram (rwx) : ORIGIN = 0x10000000, LENGTH = 32K
}

REGION_ALIAS("stack", ccmsram);
__keel_stack_size = 4K;
