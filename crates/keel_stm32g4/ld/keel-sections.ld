/* SPDX-License-Identifier: Apache-2.0 */
/* Keel L0 linker script for the STM32G4 (Startup = "keel").
   The board's memory.ld, generated by tools/memgen, names the
   regions flash, sram and ccmsram, and aliases one of them as
   stack. The RP2350's script, without the boot block. */
INCLUDE memory.ld

/* Pull keel-startup.o out of the library, then start there. */
EXTERN(keel_reset_handler)
ENTRY(keel_reset_handler)

/* Interrupt N goes to keel_isr_N: the program's, if it exports one,
   or else keel_default_handler. */
PROVIDE(keel_isr_0 = keel_default_handler);
PROVIDE(keel_isr_1 = keel_default_handler);
PROVIDE(keel_isr_2 = keel_default_handler);
PROVIDE(keel_isr_3 = keel_default_handler);
PROVIDE(keel_isr_4 = keel_default_handler);
PROVIDE(keel_isr_5 = keel_default_handler);
PROVIDE(keel_isr_6 = keel_default_handler);
PROVIDE(keel_isr_7 = keel_default_handler);
PROVIDE(keel_isr_8 = keel_default_handler);
PROVIDE(keel_isr_9 = keel_default_handler);
PROVIDE(keel_isr_10 = keel_default_handler);
PROVIDE(keel_isr_11 = keel_default_handler);
PROVIDE(keel_isr_12 = keel_default_handler);
PROVIDE(keel_isr_13 = keel_default_handler);
PROVIDE(keel_isr_14 = keel_default_handler);
PROVIDE(keel_isr_15 = keel_default_handler);
PROVIDE(keel_isr_16 = keel_default_handler);
PROVIDE(keel_isr_17 = keel_default_handler);
PROVIDE(keel_isr_18 = keel_default_handler);
PROVIDE(keel_isr_19 = keel_default_handler);
PROVIDE(keel_isr_20 = keel_default_handler);
PROVIDE(keel_isr_21 = keel_default_handler);
PROVIDE(keel_isr_22 = keel_default_handler);
PROVIDE(keel_isr_23 = keel_default_handler);
PROVIDE(keel_isr_24 = keel_default_handler);
PROVIDE(keel_isr_25 = keel_default_handler);
PROVIDE(keel_isr_26 = keel_default_handler);
PROVIDE(keel_isr_27 = keel_default_handler);
PROVIDE(keel_isr_28 = keel_default_handler);
PROVIDE(keel_isr_29 = keel_default_handler);
PROVIDE(keel_isr_30 = keel_default_handler);
PROVIDE(keel_isr_31 = keel_default_handler);
PROVIDE(keel_isr_32 = keel_default_handler);
PROVIDE(keel_isr_33 = keel_default_handler);
PROVIDE(keel_isr_34 = keel_default_handler);
PROVIDE(keel_isr_35 = keel_default_handler);
PROVIDE(keel_isr_36 = keel_default_handler);
PROVIDE(keel_isr_37 = keel_default_handler);
PROVIDE(keel_isr_38 = keel_default_handler);
PROVIDE(keel_isr_39 = keel_default_handler);
PROVIDE(keel_isr_40 = keel_default_handler);
PROVIDE(keel_isr_41 = keel_default_handler);
PROVIDE(keel_isr_42 = keel_default_handler);
PROVIDE(keel_isr_43 = keel_default_handler);
PROVIDE(keel_isr_44 = keel_default_handler);
PROVIDE(keel_isr_45 = keel_default_handler);
PROVIDE(keel_isr_46 = keel_default_handler);
PROVIDE(keel_isr_47 = keel_default_handler);
PROVIDE(keel_isr_48 = keel_default_handler);
PROVIDE(keel_isr_49 = keel_default_handler);
PROVIDE(keel_isr_50 = keel_default_handler);
PROVIDE(keel_isr_51 = keel_default_handler);
PROVIDE(keel_isr_52 = keel_default_handler);
PROVIDE(keel_isr_53 = keel_default_handler);
PROVIDE(keel_isr_54 = keel_default_handler);
PROVIDE(keel_isr_55 = keel_default_handler);
PROVIDE(keel_isr_56 = keel_default_handler);
PROVIDE(keel_isr_57 = keel_default_handler);
PROVIDE(keel_isr_58 = keel_default_handler);
PROVIDE(keel_isr_59 = keel_default_handler);
PROVIDE(keel_isr_60 = keel_default_handler);
PROVIDE(keel_isr_61 = keel_default_handler);
PROVIDE(keel_isr_62 = keel_default_handler);
PROVIDE(keel_isr_63 = keel_default_handler);
PROVIDE(keel_isr_64 = keel_default_handler);
PROVIDE(keel_isr_65 = keel_default_handler);
PROVIDE(keel_isr_66 = keel_default_handler);
PROVIDE(keel_isr_67 = keel_default_handler);
PROVIDE(keel_isr_68 = keel_default_handler);
PROVIDE(keel_isr_69 = keel_default_handler);
PROVIDE(keel_isr_70 = keel_default_handler);
PROVIDE(keel_isr_71 = keel_default_handler);
PROVIDE(keel_isr_72 = keel_default_handler);
PROVIDE(keel_isr_73 = keel_default_handler);
PROVIDE(keel_isr_74 = keel_default_handler);
PROVIDE(keel_isr_75 = keel_default_handler);
PROVIDE(keel_isr_76 = keel_default_handler);
PROVIDE(keel_isr_77 = keel_default_handler);
PROVIDE(keel_isr_78 = keel_default_handler);
PROVIDE(keel_isr_79 = keel_default_handler);
PROVIDE(keel_isr_80 = keel_default_handler);
PROVIDE(keel_isr_81 = keel_default_handler);
PROVIDE(keel_isr_82 = keel_default_handler);
PROVIDE(keel_isr_83 = keel_default_handler);
PROVIDE(keel_isr_84 = keel_default_handler);
PROVIDE(keel_isr_85 = keel_default_handler);
PROVIDE(keel_isr_86 = keel_default_handler);
PROVIDE(keel_isr_87 = keel_default_handler);
PROVIDE(keel_isr_88 = keel_default_handler);
PROVIDE(keel_isr_89 = keel_default_handler);
PROVIDE(keel_isr_90 = keel_default_handler);
PROVIDE(keel_isr_91 = keel_default_handler);
PROVIDE(keel_isr_92 = keel_default_handler);
PROVIDE(keel_isr_93 = keel_default_handler);
PROVIDE(keel_isr_94 = keel_default_handler);
PROVIDE(keel_isr_95 = keel_default_handler);
PROVIDE(keel_isr_96 = keel_default_handler);
PROVIDE(keel_isr_97 = keel_default_handler);
PROVIDE(keel_isr_98 = keel_default_handler);
PROVIDE(keel_isr_99 = keel_default_handler);
PROVIDE(keel_isr_100 = keel_default_handler);
PROVIDE(keel_isr_101 = keel_default_handler);

/* Flash: the vector table first, then code and constants. */
SECTIONS
{
  /* After reset the core reads its stack pointer and reset vector
     from the start of flash, which the boot pins map at 0. */
  .text :
  {
    KEEP(*(.keel.vectors))
    *(.text .text.*)
    *(.rodata .rodata.*)
    . = ALIGN(4);
    __keel_text_end = .;
  } > flash
  .ARM.exidx :
  {
    *(.ARM.exidx*)
  } > flash
}

/* SRAM: code that runs from RAM, .data, then .bss. */
SECTIONS
{
  .time_critical :
  {
    __keel_data_start = .;
    *(.time_critical .time_critical.*)
    . = ALIGN(4);
    __keel_time_critical_end = .;
  } > sram AT > flash
  __keel_data_load = LOADADDR(.time_critical);
  .data :
  {
    *(.data .data.*)
    . = ALIGN(4);
    __keel_data_end = .;
  } > sram AT > flash
  ASSERT(LOADADDR(.data) - __keel_data_load
         == ADDR(.data) - __keel_data_start,
         "keel: .time_critical and .data must be one block")
  .bss (NOLOAD) :
  {
    __keel_bss_start = .;
    *(.bss .bss.* COMMON)
    . = ALIGN(4);
    __keel_bss_end = .;
  } > sram
}

/* The main stack, in the region memory.toml chose */
SECTIONS
{
  .stack (NOLOAD) :
  {
    . = ALIGN(8);
    __keel_stack_start = .;
    . += __keel_stack_size;
    __keel_stack_end = .;
  } > stack
}
