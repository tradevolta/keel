/* SPDX-License-Identifier: Apache-2.0 */
/* Keel L0 linker script for the RP2350 (Startup = "keel").
   The board's memory.ld, generated by tools/memgen, names the
   regions flash, sram, scratch_x and scratch_y, and aliases one of
   them as stack. */
INCLUDE memory.ld

/* Pull keel-startup.o out of the library, then start there. */
EXTERN(keel_reset_handler)
ENTRY(keel_reset_handler)

/* Flash: the boot structures, then code and constants. */
SECTIONS
{
  /* The boot ROM reads the vector table at the start of the image
     and looks for the IMAGE_DEF in the first 4 KB of flash. */
  .text :
  {
    KEEP(*(.keel.vectors))
    KEEP(*(.keel.image_def))
    *(.text .text.*)
    *(.rodata .rodata.*)
    . = ALIGN(4);
    __keel_text_end = .;
  } > flash
  .ARM.exidx :
  {
    *(.ARM.exidx*)
  } > flash
}

/* SRAM: code that runs from RAM, .data, then .bss. */
SECTIONS
{
  /* Reset_Handler copies .time_critical and .data together from
     flash: one copy, from __keel_data_load. Put code here with
     Linker_Section => ".time_critical". */
  .time_critical :
  {
    __keel_data_start = .;
    *(.time_critical .time_critical.*)
    . = ALIGN(4);
    __keel_time_critical_end = .;
  } > sram AT > flash
  __keel_data_load = LOADADDR(.time_critical);
  .data :
  {
    *(.data .data.*)
    . = ALIGN(4);
    __keel_data_end = .;
  } > sram AT > flash
  ASSERT(LOADADDR(.data) - __keel_data_load
         == ADDR(.data) - __keel_data_start,
         "keel: .time_critical and .data must be one block")
  /* Zeroed by Reset_Handler. */
  .bss (NOLOAD) :
  {
    __keel_bss_start = .;
    *(.bss .bss.* COMMON)
    . = ALIGN(4);
    __keel_bss_end = .;
  } > sram
}

/* The two 4 KB banks: scratch data, and the region memory.toml
   chose for the main stack. */
SECTIONS
{
  /* Not initialized: Linker_Section => ".scratch_x" */
  .scratch_x (NOLOAD) :
  {
    *(.scratch_x .scratch_x.*)
  } > scratch_x
  /* Grows down from __keel_stack_end, 8-byte aligned (AAPCS). */
  .stack (NOLOAD) :
  {
    . = ALIGN(8);
    __keel_stack_start = .;
    . += __keel_stack_size;
    __keel_stack_end = .;
  } > stack
}
