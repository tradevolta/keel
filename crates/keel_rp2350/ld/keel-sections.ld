/* SPDX-License-Identifier: Apache-2.0 */
/* Keel L0 linker script for the RP2350 (Startup = "keel").
   The board's memory.ld, generated by tools/memgen, names the
   regions flash, sram, scratch_x and scratch_y, and aliases one of
   them as stack. */
INCLUDE memory.ld

/* Pull keel-startup.o out of the library, then start there. */
EXTERN(keel_reset_handler)
ENTRY(keel_reset_handler)

/* Interrupt N goes to keel_isr_N: the program's, if it exports one,
   or else keel_default_handler. */
PROVIDE(keel_isr_0 = keel_default_handler);
PROVIDE(keel_isr_1 = keel_default_handler);
PROVIDE(keel_isr_2 = keel_default_handler);
PROVIDE(keel_isr_3 = keel_default_handler);
PROVIDE(keel_isr_4 = keel_default_handler);
PROVIDE(keel_isr_5 = keel_default_handler);
PROVIDE(keel_isr_6 = keel_default_handler);
PROVIDE(keel_isr_7 = keel_default_handler);
PROVIDE(keel_isr_8 = keel_default_handler);
PROVIDE(keel_isr_9 = keel_default_handler);
PROVIDE(keel_isr_10 = keel_default_handler);
PROVIDE(keel_isr_11 = keel_default_handler);
PROVIDE(keel_isr_12 = keel_default_handler);
PROVIDE(keel_isr_13 = keel_default_handler);
PROVIDE(keel_isr_14 = keel_default_handler);
PROVIDE(keel_isr_15 = keel_default_handler);
PROVIDE(keel_isr_16 = keel_default_handler);
PROVIDE(keel_isr_17 = keel_default_handler);
PROVIDE(keel_isr_18 = keel_default_handler);
PROVIDE(keel_isr_19 = keel_default_handler);
PROVIDE(keel_isr_20 = keel_default_handler);
PROVIDE(keel_isr_21 = keel_default_handler);
PROVIDE(keel_isr_22 = keel_default_handler);
PROVIDE(keel_isr_23 = keel_default_handler);
PROVIDE(keel_isr_24 = keel_default_handler);
PROVIDE(keel_isr_25 = keel_default_handler);
PROVIDE(keel_isr_26 = keel_default_handler);
PROVIDE(keel_isr_27 = keel_default_handler);
PROVIDE(keel_isr_28 = keel_default_handler);
PROVIDE(keel_isr_29 = keel_default_handler);
PROVIDE(keel_isr_30 = keel_default_handler);
PROVIDE(keel_isr_31 = keel_default_handler);
PROVIDE(keel_isr_32 = keel_default_handler);
PROVIDE(keel_isr_33 = keel_default_handler);
PROVIDE(keel_isr_34 = keel_default_handler);
PROVIDE(keel_isr_35 = keel_default_handler);
PROVIDE(keel_isr_36 = keel_default_handler);
PROVIDE(keel_isr_37 = keel_default_handler);
PROVIDE(keel_isr_38 = keel_default_handler);
PROVIDE(keel_isr_39 = keel_default_handler);
PROVIDE(keel_isr_40 = keel_default_handler);
PROVIDE(keel_isr_41 = keel_default_handler);
PROVIDE(keel_isr_42 = keel_default_handler);
PROVIDE(keel_isr_43 = keel_default_handler);
PROVIDE(keel_isr_44 = keel_default_handler);
PROVIDE(keel_isr_45 = keel_default_handler);
PROVIDE(keel_isr_46 = keel_default_handler);
PROVIDE(keel_isr_47 = keel_default_handler);
PROVIDE(keel_isr_48 = keel_default_handler);
PROVIDE(keel_isr_49 = keel_default_handler);
PROVIDE(keel_isr_50 = keel_default_handler);
PROVIDE(keel_isr_51 = keel_default_handler);

/* Flash: the boot structures, then code and constants. */
SECTIONS
{
  /* The boot ROM reads the vector table at the start of the image
     and looks for the IMAGE_DEF in the first 4 KB of flash. */
  .text :
  {
    KEEP(*(.keel.vectors))
    KEEP(*(.keel.image_def))
    *(.text .text.*)
    *(.rodata .rodata.*)
    . = ALIGN(4);
    __keel_text_end = .;
  } > flash
  .ARM.exidx :
  {
    *(.ARM.exidx*)
  } > flash
}

/* SRAM: code that runs from RAM, .data, then .bss. */
SECTIONS
{
  /* Reset_Handler copies .time_critical and .data together from
     flash: one copy, from __keel_data_load. Put code here with
     Linker_Section => ".time_critical". */
  .time_critical :
  {
    __keel_data_start = .;
    *(.time_critical .time_critical.*)
    . = ALIGN(4);
    __keel_time_critical_end = .;
  } > sram AT > flash
  __keel_data_load = LOADADDR(.time_critical);
  .data :
  {
    *(.data .data.*)
    . = ALIGN(4);
    __keel_data_end = .;
  } > sram AT > flash
  ASSERT(LOADADDR(.data) - __keel_data_load
         == ADDR(.data) - __keel_data_start,
         "keel: .time_critical and .data must be one block")
  /* Zeroed by Reset_Handler. */
  .bss (NOLOAD) :
  {
    __keel_bss_start = .;
    *(.bss .bss.* COMMON)
    . = ALIGN(4);
    __keel_bss_end = .;
  } > sram
}

/* The two 4 KB banks: scratch data, and the region memory.toml
   chose for the main stack. */
SECTIONS
{
  /* Not initialized: Linker_Section => ".scratch_x" */
  .scratch_x (NOLOAD) :
  {
    *(.scratch_x .scratch_x.*)
  } > scratch_x
  /* Grows down from __keel_stack_end, 8-byte aligned (AAPCS). */
  .stack (NOLOAD) :
  {
    . = ALIGN(8);
    __keel_stack_start = .;
    . += __keel_stack_size;
    __keel_stack_end = .;
  } > stack
}
